## main/Kconfig.projbuild
```kconfig
menu "BlueRetro"

    config BLUERETRO_HW2
        bool "Enable support for HW2 features"
        default y
        help
            Select this to enable HW2 features like port detection.

    config BLUERETRO_PWR_STATE_RESTORE
        bool "Restore console power state after a power loss"
        depends on BLUERETRO_HW2
        default y
        help
            Mirror the console power state to the filesystem and re-assert it
            early in boot. Needed when the stock bistable relay is replaced by
            a volatile latch, such as a flip-flop driving a MOSFET switch,
            which comes up off whenever the adapter loses power. The stock
            relay held its own state and did not need this. An adapter with
            no stored state yet comes up on.

    config BLUERETRO_IO0_QDP_PWR_OFF
        bool "Power the console off on an IO0 quick double press"
        depends on BLUERETRO_HW2
        default n
        help
            Upstream behaviour since v24.04: a short IO0 press resets the
            console, and a second press within two seconds powers it off.
            The window is wide and the gesture is easy to hit by accident
            when you only meant to reset, so it is off by default here.
            Reset, pairing and factory reset on IO0 are unaffected.

    config BLUERETRO_IO0_RST_HOLD
        bool "Hold the console in reset on an IO0 triple press and hold"
        depends on BLUERETRO_HW2 && !BLUERETRO_IO0_QDP_PWR_OFF
        default y
        help
            Tap IO0 three times in quick succession and keep the third tap
            held down: the console reset line stays asserted until you let
            go. GameBoy Interface parks the GameBoy Player module while reset
            is held, which is what allows swapping GameBoy carts warm.

            The first two taps reset the console as they normally would. A
            third tap that is not actually held still acts as a plain reset.

            Mutually exclusive with the quick double press power off, which
            claims the same chained tap timing.

    config BLUERETRO_GC_OTA
        bool "Accept firmware updates over the GameCube controller port"
        default n
        help
            Adds two vendor SI opcodes, 0x1E and 0x1F, that let GameCube
            homebrew push a firmware image into the OTA partition without
            Bluetooth. Useful as a recovery path when the Bluetooth stack
            itself is what got broken.

            Data arrives eight bytes at a time and is staged in RAM, then
            flushed a kilobyte at a time; the status opcode reports busy while
            flash is being written so the console knows to wait. Prototype.

    config BLUERETRO_GC_PAIR
        bool "See and forget pairings from the GameCube port"
        default n
        help
            Adds vendor SI opcodes 0x2F to 0x31, which list what the
            adapter has paired with and remove entries from it.

            Device slots turn straight into console ports, so anything
            that once paired and is not a controller keeps taking port
            one from something that should have it. Forgetting it is the
            answer that stays answered. Prototype.

    config BLUERETRO_GC_CFG
        bool "Back up and restore settings over the GameCube port"
        default n
        help
            Adds vendor SI opcodes 0x2B to 0x2E, which copy the config
            blob out to the card and back again.

            Restoring an adapter that lost its filesystem is the obvious
            use; provisioning a batch of them identically from one card,
            without driving a browser once per unit, is the one that
            earns it. Costs a staging buffer the size of the config.
            Prototype.

    config BLUERETRO_GC_BOOT
        bool "Pick the firmware slot from the GameCube port"
        default n
        help
            Adds vendor SI opcodes 0x27 to 0x29, which report what is
            installed in the factory and both OTA slots and let one be
            selected to boot next.

            The updater alternates between the two OTA slots, so the
            firmware from before the last update is still intact, and the
            factory image behind it has never been written. This turns a
            bad update into a menu entry. Prototype.

    config BLUERETRO_GC_LOG
        bool "Download the Bluetooth debug log over the GameCube port"
        default n
        help
            Adds vendor SI opcodes 0x24 to 0x26, which turn the debug capture
            bank on and off, report how much has been captured, and read it
            back a chunk at a time.

            The capture itself already exists and already lands in the memory
            card buffer. What was missing was any way to reach it without the
            Bluetooth web config, which is no help when Bluetooth is the thing
            being diagnosed. Prototype.

    config BLUERETRO_GC_APP
        bool "Expose adapter state to the GameCube companion app"
        default n
        help
            Adds vendor SI opcode 0x21, which reports the raw controller state
            as it arrives over Bluetooth, before any mapping is applied. Lets
            GameCube homebrew show a live input viewer, and is the groundwork
            for an on screen mapping wizard.

            Costs a small snapshot on every controller report. Prototype.

    config BLUERETRO_CTRL_MAP
        bool "Remember mappings per controller rather than per port"
        default n
        help
            Mappings normally belong to a console port, so changing which
            controller connects first hands one pad another's layout.

            With this on, a mapping made with the GameCube app is also saved
            against that controller's Bluetooth address and reloaded whenever
            it connects, on whichever port it lands. Stored as small files
            beside the config rather than inside it, so the config layout that
            the web tool and the config version machinery depend on is left
            alone.

            A controller that has never been mapped keeps whatever the port
            already had. One using a rotating private address will not be
            recognised again once it changes.

    config BLUERETRO_GC_FACE_MAP_TOGGLE
        bool "Let PAD_MS flip the GameCube face buttons between layouts"
        default n
        help
            Upstream behaviour: pressing and releasing PAD_MS swaps the face
            buttons between position based and name based mapping, so a
            Nintendo layout pad can be made to match an Xbox one.

            It is a bare button press, not a combo, with nothing on screen to
            say which layout is active. Hitting it by accident leaves A dead
            and X sending A, which is a long way to walk back from. Off by
            default here, since a Switch 2 GameCube pad is already laid out
            like the console it is plugged into.

    choice
        prompt "Select universal or specific system"
        default BLUERETRO_SYSTEM_UNIVERSAL
        help
            BlueRetro is an universal adapter but you may force it to support
            only one system.

        config BLUERETRO_SYSTEM_UNIVERSAL
            bool "UNIVERSAL"
            help
                Select this to support all systems.

        config BLUERETRO_SYSTEM_PARALLEL_1P
            bool "PARALLEL_1P_PP"
            help
                Select this to support only PARALLEL_1P push-pull.

        config BLUERETRO_SYSTEM_PARALLEL_2P
            bool "PARALLEL_2P_PP"
            help
                Select this to support only PARALLEL_2P push-pull.

        config BLUERETRO_SYSTEM_NES
            bool "NES"
            help
                Select this to support only NES.

        config BLUERETRO_SYSTEM_PCE
            bool "PCE"
            help
                Select this to support only PCE.

        config BLUERETRO_SYSTEM_GENESIS
            bool "MEGADRIVE/GENESIS"
            help
                Select this to support only MEGADRIVE/GENESIS.

        config BLUERETRO_SYSTEM_SNES
            bool "SNES"
            help
                Select this to support only SNES.

        config BLUERETRO_SYSTEM_CDI
            bool "CD-i"
            help
                Select this to support only CD-i.

        config BLUERETRO_SYSTEM_CD32
            bool "CD32"
            help
                Select this to support only CD32.

        config BLUERETRO_SYSTEM_3DO
            bool "3DO"
            help
                Select this to support only 3DO.

        config BLUERETRO_SYSTEM_JAGUAR
            bool "JAGUAR"
            help
                Select this to support only JAGUAR.

        config BLUERETRO_SYSTEM_PSX_PS2
            bool "PSX/PS2"
            help
                Select this to support only PSX & PS2.

        config BLUERETRO_SYSTEM_SATURN
            bool "SATURN"
            help
                Select this to support only SATURN.

        config BLUERETRO_SYSTEM_PCFX
            bool "PC-FX"
            help
                Select this to support only PC-FX.

        config BLUERETRO_SYSTEM_JVS
            bool "JVS"
            help
                Select this to support only JVS.

        config BLUERETRO_SYSTEM_N64
            bool "N64"
            help
                Select this to support only N64.

        config BLUERETRO_SYSTEM_DC
            bool "DC"
            help
                Select this to support only DC.

        config BLUERETRO_SYSTEM_GC
            bool "GC"
            help
                Select this to support only GC.

        config BLUERETRO_SYSTEM_WII_EXT
            bool "Wii ext."
            help
                Select this to support only Wii ext.

        config BLUERETRO_SYSTEM_VBOY
            bool "VB"
            help
                Select this to support only VB.

        config BLUERETRO_SYSTEM_PARALLEL_1P_OD
            bool "PARALLEL_1P_OD"
            help
                Select this to support only PARALLEL_1P open drain.

        config BLUERETRO_SYSTEM_PARALLEL_2P_OD
            bool "PARALLEL_2P_OD"
            help
                Select this to support only PARALLEL_2P open drain.

        config BLUERETRO_SYSTEM_SEA_BOARD
            bool "SEA Board"
            help
                Select this to support only SEA Board.

    endchoice

    # Which wired drivers a build actually needs, derived from the system choice
    # above. Several drivers serve more than one console (nsi does N64 and GC,
    # sega_io does Genesis and Saturn, ps_spi does PSX and PS2), so the gate has
    # to be per driver rather than per system.
    #
    # These are not user-visible; pick a system and the right set follows. A
    # UNIVERSAL build enables everything, which is the old behaviour.
    #
    # This matters for the ESP32-S31 port: each driver still carries ESP32
    # peripheral register access, so a single-system build only has to be ported
    # far enough to compile the one driver it uses.

    config BLUERETRO_DRV_MAPLE
        bool
        default y if BLUERETRO_SYSTEM_UNIVERSAL || BLUERETRO_SYSTEM_DC

    config BLUERETRO_DRV_NSI
        bool
        default y if BLUERETRO_SYSTEM_UNIVERSAL || BLUERETRO_SYSTEM_N64 || BLUERETRO_SYSTEM_GC

    config BLUERETRO_DRV_NPISO_IO
        bool
        default y if BLUERETRO_SYSTEM_UNIVERSAL || BLUERETRO_SYSTEM_NES || BLUERETRO_SYSTEM_VBOY

    config BLUERETRO_DRV_SNES_SPI
        bool
        default y if BLUERETRO_SYSTEM_UNIVERSAL || BLUERETRO_SYSTEM_SNES

    config BLUERETRO_DRV_PCE_IO
        bool
        default y if BLUERETRO_SYSTEM_UNIVERSAL || BLUERETRO_SYSTEM_PCE

    config BLUERETRO_DRV_SEGA_IO
        bool
        default y if BLUERETRO_SYSTEM_UNIVERSAL || BLUERETRO_SYSTEM_GENESIS || BLUERETRO_SYSTEM_SATURN

    config BLUERETRO_DRV_CDI_UART
        bool
        default y if BLUERETRO_SYSTEM_UNIVERSAL || BLUERETRO_SYSTEM_CDI

    config BLUERETRO_DRV_REAL_SPI
        bool
        default y if BLUERETRO_SYSTEM_UNIVERSAL || BLUERETRO_SYSTEM_3DO

    config BLUERETRO_DRV_JAG_IO
        bool
        default y if BLUERETRO_SYSTEM_UNIVERSAL || BLUERETRO_SYSTEM_JAGUAR

    config BLUERETRO_DRV_PS_SPI
        bool
        default y if BLUERETRO_SYSTEM_UNIVERSAL || BLUERETRO_SYSTEM_PSX_PS2

    config BLUERETRO_DRV_PCFX_SPI
        bool
        default y if BLUERETRO_SYSTEM_UNIVERSAL || BLUERETRO_SYSTEM_PCFX

    config BLUERETRO_DRV_JVS_UART
        bool
        default y if BLUERETRO_SYSTEM_UNIVERSAL || BLUERETRO_SYSTEM_JVS

    config BLUERETRO_DRV_WII_I2C
        bool
        default y if BLUERETRO_SYSTEM_UNIVERSAL || BLUERETRO_SYSTEM_WII_EXT

    config BLUERETRO_DRV_SEA_IO
        bool
        default y if BLUERETRO_SYSTEM_UNIVERSAL || BLUERETRO_SYSTEM_SEA_BOARD

    config BLUERETRO_DRV_PARALLEL
        bool
        default y if BLUERETRO_SYSTEM_UNIVERSAL || BLUERETRO_SYSTEM_PARALLEL_1P || BLUERETRO_SYSTEM_PARALLEL_2P || BLUERETRO_SYSTEM_PARALLEL_1P_OD || BLUERETRO_SYSTEM_PARALLEL_2P_OD

    # wired_bare.c's spi_init() drives the ESP32 SPI slave peripheral and exists
    # only for the four SPI-based drivers. Nothing else needs it.
    config BLUERETRO_DRV_SPI_SLAVE
        bool
        default y if BLUERETRO_DRV_PS_SPI || BLUERETRO_DRV_PCFX_SPI || BLUERETRO_DRV_REAL_SPI || BLUERETRO_DRV_SNES_SPI

    # Port auto-detection only runs on a UNIVERSAL build; a single-system build
    # already knows what it is talking to.
    config BLUERETRO_DRV_DETECT
        bool
        default y if BLUERETRO_SYSTEM_UNIVERSAL

    menu "Debug"

        config BLUERETRO_QEMU
            bool "Enable QEMU friendly config"
            help
                Select this to make an image for QEMU.

        config BLUERETRO_WS_CMDS
            bool "Enable websocket cmds"
            help
                Select this to enable websocket cmds.

        config BLUERETRO_BT_DISABLE
            bool "Disable Bluetooth init"
            help
                Select this to disable Bluetooth init.

        config BLUERETRO_BT_H4_TRACE
            bool "Enable Bluetooth H4 tracing"
            help
                Select this to enable Bluetooth H4 tracing.

        config BLUERETRO_BT_SSP_DBG
            bool "Enable Bluetooth SSP debug mode"
            help
                Select this to enable Bluetooth SSP debug mode.

        config BLUERETRO_GENERIC_HID_DEBUG
            bool "Enable Generic HID report debug"
            help
                Select this to enable Generic HID report debug.

        config BLUERETRO_DUMP_HID_DESC
            bool "Enable HID descriptor dump"
            help
                Select this to dump HID descriptor.

        config BLUERETRO_TEST_FALLBACK_REPORT
            bool "Enable testing fallback report"
            help
                Select this to test fallback report.

        config BLUERETRO_RAW_REPORT_DUMP
            bool "Enable RAW report dump"
            help
                Select this to dump RAW report data.

        config BLUERETRO_ADAPTER_BTNS_DBG
            bool "Enable adapter buttons debug"
            help
                Select this to enable adapter buttons debug.

        config BLUERETRO_ADAPTER_RUMBLE_DBG
            bool "Enable adapter rumble debug"
            help
                Select this to enable adapter rumble debug.

        config BLUERETRO_ADAPTER_RUMBLE_TEST
            bool "Enable adapter rumble test"
            help
                Select this to enable adapter rumble test.

        config BLUERETRO_ADAPTER_INPUT_DBG
            bool "Enable adapter input debug"
            help
                Select this to enable adapter input debug.

        config BLUERETRO_ADAPTER_INPUT_MAP_DBG
            bool "Enable adapter input mapping debug"
            help
                Select this to enable adapter input mapping debug.

        config BLUERETRO_WIRED_TRACE
            bool "Enable wired trace"
            help
                Select this to enable wired trace.

        config BLUERETRO_BT_TIMING_TESTS
            bool "Enable Bluetooth timing tests"
            help
                Select this to enable Bluetooth timeing tests.

        config BLUERETRO_BT_REPORT_INTERVAL_STATS
            bool "Print interval between receive Bluetooth HID report"
            depends on BLUERETRO_BT_TIMING_TESTS
            help
                Print interval between receive Bluetooth HID report.

        choice
            prompt "Enable Bluetooth minimum latency test on GPIO26"
            depends on BLUERETRO_BT_TIMING_TESTS
            optional
            help
                Select to enable Bluetooth minimum latency test.

            config BLUERETRO_BT_MIN_LATENCY_TEST_PS3
                bool "PS3"

            config BLUERETRO_BT_MIN_LATENCY_TEST_PS4
                bool "PS4"

            config BLUERETRO_BT_MIN_LATENCY_TEST_PS5
                bool "PS5"

            config BLUERETRO_BT_MIN_LATENCY_TEST_WIIU
                bool "WIIU"

            config BLUERETRO_BT_MIN_LATENCY_TEST_XB1
                bool "XB1"

            config BLUERETRO_BT_MIN_LATENCY_TEST_SW
                bool "SW"

        endchoice

        config BLUERETRO_BTMON_VERBOSE
            bool "Enable verbose loggin into BT monitor"
            help
                Seclect this to enable verbose loggin into BT monitor.

        config BLUERETRO_COVERAGE
            bool "Enable gcov coverage logging"
            help
                Seclect this to enable gcov coverage logging.

    endmenu

endmenu
```
